GLOBAL &load_image

&load_image=""

; Change this to "yes" to start up ITM logging
&itm_dmsc="no"

print "Connecting to QT Lauterbach - m3..."

RESet
SYStem.RESet
SYStem.Option RESBREAK OFF
SYStem.Option EnReset OFF
System.Option MemStatusCheck ON
System.CONFIG DEBUGTIMESCALE 32.
;SYStem.POLLING OFF
setup.urate 500.ms            ; slow window updates, this can be bigger
system.polling slow           ; spase pinging
SYSTEM.JTAGCLOCK RTCK 100kHz


SYStem.CPU CortexM3

SYStem.CONFIG APBACCESSPORT 1
SYStem.CONFIG DEBUGACCESSPORT 7
SYStem.CONFIG AXIACCESSPORT 2
SYStem.CONFIG MEMORYACCESSPORT 7
SYStem.CONFIG JTAGACCESSPORT 5

SYStem.CONFIG DAPIRPRE 0.
SYStem.CONFIG DAPDRPRE 0.
SYStem.CONFIG DAPIRPOST 0.
SYStem.CONFIG DAPDRPOST 0.

SYStem.CONFIG.DWT.Base E:0xE0001000
SYStem.CONFIG CTI BASE APB:0x3C016000
system.config ETB.base  APB:0x3C025000
system.config TPIU.base APB:0x20004000

if "&itm_dmsc"==""
(
	itm.PCSampler 1/64
	itm.on
)

AREA
SYStem.Mode Attach

break


B::

TOOLBAR ON
STATUSBAR ON
FramePOS 4.3333 2.0 240. 75.
WinPAGE.RESet

WinPAGE.Create P000
WinCLEAR

WinPOS 106.67 7.0 74. 20. 0. 0. W002
ws.register.view /sl

if "&itm_dmsc"==""
(
	WinPOS 10.667 0.58333 78. 26. 8. 1. W000
	WinTABS 32.
	ws.itmtrace.list
)

WinPOS 0.66667 26.0 100. 26. 24. 1. W003
WinTABS 10. 10. 25. 62.
ws.LIST /markPC

WinPAGE.select P000

ENDDO
