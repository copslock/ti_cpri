PARAMETERS &elf_dir &optional_subdir
GLOBAL &load_image &sysfw &sysbios

if "&sysbios"==""
(
	&sysbios="no"
)

; Change this to "no" to stop showing the log
&log_buf="yes"

;Default location
&sysfw="~/Src/TI_Prop/KS3/sysfw/system-firmware"
&bdir="osal/tirtos"

print "elf_dir: &elf_dir"
if "&elf_dir"!=""
(
	&sysfw="&elf_dir"
	&bdir="."
	if "&optional_subdir"!=""
	(
		 &bdir="&optional_subdir"
	)
)
&elf_name="ti-sci-firmware-dra82x-gp-zebu.elf"
&elf="&sysfw/&elf_name"

; To use elf locally.. use the following
&verify=""
; To use sideloading.. use the following
;&verify="/nocode"
; To check... use the following
;&verify="/compare"

Data.LOAD.Elf &elf  &verify /register

if "&sysbios"=="yes"
(
	task.config ~~/demo/arm/kernel/sysbios/sysbios
	menu.reprogram ~~/demo/arm/kernel/sysbios/sysbios
	; We have really slow access.
	EXTension.timeout 1000000
)

B::

TOOLBAR ON
STATUSBAR ON
FramePOS 31.667 15.667 240. 75.
WinPAGE.RESet

WinPAGE.Create P000
WinCLEAR

WinPOS 0.0 0.0 61. 22. 0. 0. W001
ws.register.view /sl

WinPOS 0.16667 32.417 155. 25. 0. 0. W000
ws.per , "System Control"

WinPOS 64.167 0.25 104. 25. 16. 1. W002
WinTABS 10. 10. 25. 62.
ws.LIST

if "&log_buf"=="yes"
(
	&log_start=E:VAR.VALUE(&_logbuf_first)
	&log_end=E:VAR.VALUE(&_logbuf_last)

	;Print "Resetting Log buffer region"
	DATA.SET &log_start--&log_end 0x0

	WinPOS 103.33 22.167 100. 25. 0. 0. W005
	Data.dump &log_start--&log_end  /sl /Ascii /NoHex
)

WinPAGE.select P000

; Clean up all preexisting breakpoints
b.reset

print "Setup Breakpoint for osal_system_halt"
b.s osal_system_halt /onchip

print "Setup Breakpoint for NULL pointer exception. Ready to Go.."
b.s 0x0 /readwrite /onchip

ENDDO
