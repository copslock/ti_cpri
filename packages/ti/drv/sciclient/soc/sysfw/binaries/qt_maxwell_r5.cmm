GLOBAL &no_reset_cpus &qt_r5_cores &no_break
LOCAL &rcpu0 &rcpu1 &loop_addr &loop


print "Connecting to QT Lauterbach - R5..."

; If we dont want to reset the CPUs (example with deadloop code) - change to 1
if "&no_reset_cpus"==""
(
	;&no_reset_cpus="1"
	&no_reset_cpus=""
)

; QT r5 cores - 1 to 2 indicates single instance, else a0 to a1 for specific cpu or "ask"
if "&qt_r5_cores"==""
(
	&qt_r5_cores="1"
)

; Where do we want the CPUs to loop when reset?
;&loop_addr=AD:0x41C00000
&loop_addr=0
&pc_addr=AD:0x41C00000

RESet
SYStem.RESet
SYStem.Option RESBREAK OFF
SYStem.Option EnReset OFF
System.Option MemStatusCheck ON
System.CONFIG DEBUGTIMESCALE 32.
;SYStem.POLLING OFF
setup.urate 2500.ms            ; slow window updates, this can be bigger
system.polling slow           ; spase pinging
SYSTEM.JTAGCLOCK RTCK 100kHz


SYStem.CPU CortexR5MPCore

system.config ETB.base APB:0x3C025000
system.config TPIU.base APB:0x20004000

GOSUB WINDOW_SETUP

&found=0
if "&qt_r5_cores"=="ask"
(
	PRINT "Enter CPU cores:a0-a1 specific cores or 1-2: "
	ENTER &qt_r5_cores
)

if "&qt_r5_cores"=="a0"
(
	SYStem.CONFIG CORENUMBER 1
	CORE.ASSIGN 1.
	SYStem.CONFIG COREDEBUG BASE DAP:0x9D010000
	system.config etm Base DAP:0x9D01C000
	&found=1
	&rcpu0=1
)
if "&qt_r5_cores"=="a1"
(
	SYStem.CONFIG CORENUMBER 1
	CORE.ASSIGN 1.
	SYStem.CONFIG COREDEBUG BASE DAP:0x9D012000
	system.config etm Base DAP:0x9D01D000
	&found=1
	&rcpu0=1
)
if "&qt_r5_cores"=="1"
(
	SYStem.CONFIG CORENUMBER 1
	CORE.ASSIGN 1.
	SYStem.CONFIG COREDEBUG BASE DAP:0x9D010000
	system.config etm Base DAP:0x9D01C000
	&found=1
	&rcpu0=1
)
if "&qt_r5_cores"=="2"
(
	SYStem.CONFIG CORENUMBER 2
	CORE.ASSIGN 1. 2.
	SYStem.CONFIG COREDEBUG BASE DAP:0x9D010000 DAP:0x9D012000
	system.config etm BASE DAP:0x9D01C000 DAP:0x9D01D000
        ETM.PortMode.Wrapped   ; wrap and insert ATID
	&found=1
	&rcpu0=1
	&rcpu1=1
)
if "&found"=="0x0"
(
	DIALOG.OK "UNKNOWN '&qt_r5_cores core' selected"
	PRINT "INVALID CORE SELECTION. STOP.. Valid options are: AMP: a0-a1, SMP: 1-2"
	ENDDO
)

; Disable Cflush (Lauterbach workaround)
system.option.CFLUSH.off

SYStem.CONFIG APBACCESSPORT 1
SYStem.CONFIG DEBUGACCESSPORT 1
SYStem.CONFIG AXIACCESSPORT 2
SYStem.CONFIG MEMORYACCESSPORT 2
SYStem.CONFIG JTAGACCESSPORT 5

SYStem.CONFIG DAPIRPRE 0.
SYStem.CONFIG DAPDRPRE 0.
SYStem.CONFIG DAPIRPOST 0.
SYStem.CONFIG DAPDRPOST 0.

SYStem.Mode Attach

if "&no_break"==""
(
	break
)

if "&no_reset_cpus"==""
(
	print "Resetting CPUs and setting PC to deadloop &loop_addr"
	if "&rcpu0"=="0x1"
	(
		GOSUB RESET_R5 0
	)
	if "&rcpu1"=="0x1"
	(
		GOSUB RESET_R5 1
	)
	core.select 0
	if "&loop_addr"!="0x0"
	(
		print "Setting up a dead loop in &loop_addr"
		data.set &loop_addr %LE %Long 0xEAFFFFFE
	)
)

Print "Connected - R5s!"
GOSUB WINDOW_FINAL
ENDDO

RESET_R5:
(
	ENTRY &core

	; reset all the registers to defaults

	core.select &core

	; Disable MPU if already enabled
	print "R5_CPU&core Disabling MPU..."
	PER.Set c15:0x1 %Long 0xE50878

	; Reset all registers for CPU
	print "R5_CPU&core Resetting registers.."
	register.reset
	; Setup our parking space.
	register.set PC &pc_addr
	register.set CPSR 0x1D3

	RETURN
)

WINDOW_SETUP:
(
	 B::

	 TOOLBAR ON
	 STATUSBAR ON
	 FramePOS 11.667 6.5833 237. 63.
	 WinPAGE.RESet

	 WinPAGE.Create P000
	 WinCLEAR

	 WinPOS 0.0 20.333 100. 25. 0. 0. W004
	 ws.AREA.view

	 WinPOS 105.17 0.41667 29. 5. 0. 0. W001
	 ws.core.showactive

	 WinPOS 138.5 0.083333 59. 21. 0. 0. W002
	 ws.register.view /sl

	 WinPOS 103.83 25.167 94. 12. 0. 1. W000
	 WinTABS 42. 6. 26. 0.
	 ws.data.log
	 WinPAN 0. 2.

	 WinPAGE.select P000
	 RETURN
)

WINDOW_FINAL:
(
	 WinPOS 0.0 0.0 98. 14. 24. 1. W003
	 WinTABS 10. 10. 25. 62.
	 ws.LIST /markPC
)
